#include "ssd1306_driver.h"
#include "i2c_manager.h"
#include "board_config.h"
#include "esp_log.h"
#include "freertos/FreeRTOS.h"
#include "freertos/task.h"
#include <string.h>

static const char *TAG = "SSD1306";
static i2c_master_dev_handle_t s_ssd1306_handle = NULL;
static bool s_ready = false;

// 128x64 display framebuffer: 8 pages x 128 columns = 1024 bytes
static uint8_t s_framebuffer[SSD1306_PAGES * SSD1306_WIDTH];
// Transmission buffer with 0x40 data prefix byte
static uint8_t s_tx_buffer[1 + sizeof(s_framebuffer)];

// Basic 8x8 ASCII font (characters 32 ' ' to 126 '~')
static const uint8_t font8x8[95][8] = {
    {0x00, 0x00, 0x00, 0x00, 0x00, 0x00, 0x00, 0x00}, // 32 ' '
    {0x18, 0x3C, 0x3C, 0x18, 0x18, 0x00, 0x18, 0x00}, // 33 '!'
    {0x66, 0x66, 0x24, 0x00, 0x00, 0x00, 0x00, 0x00}, // 34 '"'
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    {0x76, 0xDC, 0x00, 0x00, 0x00, 0x00, 0x00, 0x00}, // 126 '~'
};

static esp_err_t ssd1306_send_cmd(uint8_t cmd)
{
    if (s_ssd1306_handle == NULL) return ESP_ERR_INVALID_STATE;
    uint8_t buf[2] = {0x00, cmd};
    return i2c_master_transmit(s_ssd1306_handle, buf, sizeof(buf), pdMS_TO_TICKS(50));
}

esp_err_t ssd1306_init(void)
{
    if (s_ready) return ESP_OK;

    i2c_master_bus_handle_t bus = i2c_manager_get_bus();
    if (bus == NULL) {
        ESP_LOGE(TAG, "I2C bus not ready");
        return ESP_ERR_INVALID_STATE;
    }

    i2c_device_config_t dev_cfg = {
        .dev_addr_length = I2C_ADDR_BIT_LEN_7,
        .device_address = SSD1306_I2C_ADDR,
        .scl_speed_hz = I2C_FREQ_HZ,
    };

    esp_err_t ret = i2c_master_bus_add_device(bus, &dev_cfg, &s_ssd1306_handle);
    if (ret != ESP_OK) {
        ESP_LOGE(TAG, "Failed to register SSD1306 device: %s", esp_err_to_name(ret));
        return ret;
    }

    i2c_manager_acquire();

    // Standard SSD1306 Initialization sequence for 128x64 display
    const uint8_t init_cmds[] = {
        0xAE,       // Display OFF
        0xD5, 0x80, // Set display clock divide ratio / osc frequency
        0xA8, 0x3F, // Set multiplex ratio (64 lines)
        0xD3, 0x00, // Set display offset (0)
        0x40,       // Set start line (0)
        0x8D, 0x14, // Charge Pump Enable (Internal VCC)
        0x20, 0x00, // Memory Addressing Mode: Horizontal Addressing
        0xA1,       // Segment Re-map: Column 127 is mapped to SEG0
        0xC8,       // COM Output Scan Direction: remapped
        0xDA, 0x12, // COM Pins hardware config: alternative
        0x81, 0xCF, // Contrast Control
        0xD9, 0xF1, // Pre-charge Period
        0xDB, 0x40, // VCOMH Deselect Level
        0xA4,       // Entire Display ON resume
        0xA6,       // Normal Display (not inverted)
        0xAF        // Display ON
    };

    for (size_t i = 0; i < sizeof(init_cmds); i++) {
        ret = ssd1306_send_cmd(init_cmds[i]);
        if (ret != ESP_OK) {
            i2c_manager_release();
            ESP_LOGW(TAG, "SSD1306 init cmd failed at index %d: %s", (int)i, esp_err_to_name(ret));
            i2c_manager_increment_error();
            return ret;
        }
    }

    i2c_manager_release();

    s_ready = true;
    ssd1306_clear();
    ssd1306_update();

    ESP_LOGI(TAG, "SSD1306 OLED (128x64) initialized successfully at address 0x%02X", SSD1306_I2C_ADDR);
    return ESP_OK;
}

bool ssd1306_is_ready(void)
{
    return s_ready;
}

esp_err_t ssd1306_clear(void)
{
    memset(s_framebuffer, 0x00, sizeof(s_framebuffer));
    return ESP_OK;
}

esp_err_t ssd1306_write_line(uint8_t row, const char *text)
{
    if (row >= SSD1306_PAGES || text == NULL) {
        return ESP_ERR_INVALID_ARG;
    }

    // Clear target page (128 bytes)
    uint8_t *page_ptr = &s_framebuffer[row * SSD1306_WIDTH];
    memset(page_ptr, 0x00, SSD1306_WIDTH);

    size_t len = strlen(text);
    if (len > 16) len = 16; // 128 / 8 = 16 characters per line

    for (size_t i = 0; i < len; i++) {
        char c = text[i];
        if (c < 32 || c > 126) c = ' ';
        const uint8_t *glyph = font8x8[(int)(c - 32)];

        // Rotate glyph bits to match SSD1306 page byte vertical orientation
        for (int col = 0; col < 8; col++) {
            uint8_t col_byte = 0;
            for (int bit = 0; bit < 8; bit++) {
                if (glyph[bit] & (1 << (7 - col))) {
                    col_byte |= (1 << bit);
                }
            }
            page_ptr[i * 8 + col] = col_byte;
        }
    }

    return ESP_OK;
}

esp_err_t ssd1306_update(void)
{
    if (!s_ready || s_ssd1306_handle == NULL) {
        return ESP_ERR_INVALID_STATE;
    }

    i2c_manager_acquire();

    // Set Column Address (0 to 127)
    ssd1306_send_cmd(0x21);
    ssd1306_send_cmd(0x00);
    ssd1306_send_cmd(SSD1306_WIDTH - 1);

    // Set Page Address (0 to 7)
    ssd1306_send_cmd(0x22);
    ssd1306_send_cmd(0x00);
    ssd1306_send_cmd(SSD1306_PAGES - 1);

    // Prepare transmission with 0x40 data prefix
    s_tx_buffer[0] = 0x40; // Co=0, D/C#=1 (Data)
    memcpy(&s_tx_buffer[1], s_framebuffer, sizeof(s_framebuffer));

    esp_err_t ret = i2c_master_transmit(s_ssd1306_handle, s_tx_buffer, sizeof(s_tx_buffer), pdMS_TO_TICKS(100));
    i2c_manager_release();

    if (ret != ESP_OK) {
        i2c_manager_increment_error();
    }
    return ret;
}
